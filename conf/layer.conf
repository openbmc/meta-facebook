## conf/layer.conf
```bitbake
# We have a conf and classes directory, add to BBPATH
BBPATH .= ":${LAYERDIR}"

# We have recipes-* directories, add to BBFILES
BBFILES += "${LAYERDIR}/meta-common/recipes-*/*/*.bb \
            ${LAYERDIR}/meta-common/recipes-*/*/*.bbappend"

BBFILE_COLLECTIONS += "facebook-layer"
BBFILE_PATTERN_facebook-layer := "^${LAYERDIR}/"
LAYERSERIES_COMPAT_facebook-layer := "warrior zeus"
```
